## package/klipper/python-streaming-form-data/Config.in
```kconfig
config BR2_PACKAGE_PYTHON_STREAMING_FORM_DATA
	bool "python-streaming-form-data"
	select BR2_PACKAGE_PYTHON_NUMPY
	select BR2_PACKAGE_PYTHON_PROMPT_TOOLKIT
	select BR2_PACKAGE_PYTHON_PYGMENTS
	help
	  Python bindings for the docker credentials store API.

	  https://github.com/shin-/dockerpy-creds
```

## package/libimobiledevice/Config.in
```kconfig
config BR2_PACKAGE_LIBIMOBILEDEVICE
	bool "libimobiledevice"
	select BR2_PACKAGE_OPENSSL
	help
	  A library to communicate with services on iOS devices
	  using native protocols.

	  https://github.com/libimobiledevice/libimobiledevice
```

## package/libirecovery/Config.in
```kconfig
config BR2_PACKAGE_LIBIRECOVERY
	bool "libirecovery"
	help
	  The libirecovery library allows communication with iBoot/iBSS of iOS devices via USB.

	  https://github.com/libimobiledevice/libirecovery
```

## package/myjpeg/Config.in
```kconfig
config BR2_PACKAGE_MYJPEG
	bool "myjpeg"
	depends on BR2_INSTALL_LIBSTDCPP
	help
	  Display jpeg

comment "imuspx4 needs a toolchain w/ C++"
	depends on !BR2_INSTALL_LIBSTDCPP
```
