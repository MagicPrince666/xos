## board/friendlyarm/nanopi-neo/friendlyarm_nanopi_neo_defconfig
```kconfig
BR2_arm=y
BR2_cortex_a7=y
BR2_ARM_FPU_VFPV4=y

BR2_TARGET_GENERIC_HOSTNAME="neo"
BR2_TARGET_GENERIC_ISSUE="Welcome Leo"
BR2_TARGET_GENERIC_ROOT_PASSWD=""

# Linux headers same as kernel, a 5.3 series
BR2_TOOLCHAIN_BUILDROOT_VENDOR="neo"
BR2_TOOLCHAIN_BUILDROOT_GLIBC=y
BR2_PACKAGE_HOST_LINUX_HEADERS_CUSTOM_5_4=y

BR2_TOOLCHAIN_BUILDROOT_CXX=y
BR2_GCC_ENABLE_LTO=y

# Use a -rc kernel to get the DTS
BR2_LINUX_KERNEL=y
BR2_LINUX_KERNEL_CUSTOM_VERSION=y
BR2_LINUX_KERNEL_CUSTOM_VERSION_VALUE="5.4.113"
BR2_LINUX_KERNEL_USE_CUSTOM_CONFIG=y
BR2_LINUX_KERNEL_CUSTOM_CONFIG_FILE="board/friendlyarm/nanopi-neo/linux.defconfig"
BR2_LINUX_KERNEL_DTS_SUPPORT=y
BR2_LINUX_KERNEL_CUSTOM_DTS_PATH="board/friendlyarm/nanopi-neo/devicetree/linux/sun8i-h3-nanopi-neo.dts"

# Use an -rc tag because the defconfig is very recent
BR2_TARGET_UBOOT=y
BR2_TARGET_UBOOT_BUILD_SYSTEM_KCONFIG=y
BR2_TARGET_UBOOT_CUSTOM_VERSION=y
BR2_TARGET_UBOOT_CUSTOM_VERSION_VALUE="2020.07"
BR2_TARGET_UBOOT_USE_CUSTOM_CONFIG=y
BR2_TARGET_UBOOT_CUSTOM_CONFIG_FILE="board/friendlyarm/nanopi-neo/uboot.config"
# BR2_TARGET_UBOOT_BOARD_DEFCONFIG="nanopi_neo"
BR2_TARGET_UBOOT_CUSTOM_DTS_PATH="board/friendlyarm/nanopi-neo/devicetree/uboot/sun8i-h3-nanopi.dtsi board/friendlyarm/nanopi-neo/devicetree/uboot/sun8i-h3-nanopi-neo.dts"
BR2_TARGET_UBOOT_NEEDS_DTC=y
BR2_TARGET_UBOOT_NEEDS_PYLIBFDT=y
BR2_TARGET_UBOOT_FORMAT_CUSTOM=y
BR2_TARGET_UBOOT_FORMAT_CUSTOM_NAME="u-boot-sunxi-with-spl.bin"
BR2_TARGET_UBOOT_TOOLS=y
BR2_TARGET_UBOOT_BOOT_SCRIPT=y
BR2_TARGET_UBOOT_BOOT_SCRIPT_SOURCE="board/friendlyarm/nanopi-neo/boot.cmd"

# Build an sdcard image
BR2_ROOTFS_DEVICE_CREATION_DYNAMIC_EUDEV=y
BR2_ROOTFS_OVERLAY="board/friendlyarm/nanopi-neo/rootfs"
BR2_TARGET_ROOTFS_SQUASHFS=y
BR2_TARGET_ROOTFS_SQUASHFS4_GZIP=y
BR2_ROOTFS_POST_IMAGE_SCRIPT="support/scripts/genimage.sh"
BR2_ROOTFS_POST_SCRIPT_ARGS="-c board/friendlyarm/nanopi-neo/genimage.cfg"
# BR2_TARGET_ROOTFS_TAR is not set

# Additional tools
BR2_PACKAGE_HOST_PYTHON3=y
BR2_PACKAGE_HOST_PYTHON3_SSL=y
BR2_PACKAGE_HOST_UBOOT_TOOLS=y
BR2_PACKAGE_HOST_UBOOT_TOOLS_FIT_SUPPORT=y
BR2_PACKAGE_HOST_UBOOT_TOOLS_FIT_SIGNATURE_SUPPORT=y
BR2_PACKAGE_HOST_DOSFSTOOLS=y
BR2_PACKAGE_HOST_GENIMAGE=y
BR2_PACKAGE_HOST_MTOOLS=y
BR2_PACKAGE_BUSYBOX_SHOW_OTHERS=y
BR2_PACKAGE_VIM=y
# BR2_PACKAGE_DNSMASQ=y
BR2_PACKAGE_IPROUTE2=y
BR2_PACKAGE_E2FSPROGS=y
BR2_PACKAGE_E2FSPROGS_RESIZE2FS=y
BR2_PACKAGE_LIBPLIST=y
BR2_PACKAGE_GNUTLS=y
BR2_PACKAGE_LIBGCRYPT=y
BR2_PACKAGE_READLINE=y
BR2_PACKAGE_SSHPASS=y
BR2_PACKAGE_LIBIMOBILEDEVICE=y
BR2_PACKAGE_LIBIRECOVERY=y
BR2_PACKAGE_LIBUSBMUXD=y
BR2_PACKAGE_USBMUXD=y
BR2_PACKAGE_NTP=y
BR2_PACKAGE_NTP_NTPDATE=y
BR2_PACKAGE_OPENSSH=y
BR2_PACKAGE_USBUTILS=y
BR2_PACKAGE_LRZSZ=y
BR2_PACKAGE_GZIP=y
BR2_PACKAGE_P7ZIP=y
BR2_PACKAGE_UNRAR=y
BR2_PACKAGE_XZ=y
BR2_PACKAGE_ZIP=y
BR2_PACKAGE_BZIP2=y
BR2_PACKAGE_TAR=y
BR2_PACKAGE_DROPBEAR=y
BR2_PACKAGE_SUNXI_MALI_MAINLINE=y
BR2_PACKAGE_SUNXI_MALI_MAINLINE_R6P2=y
BR2_PACKAGE_SUNXI_MALI_MAINLINE_DRIVER=y
BR2_PACKAGE_LIBDRM=y
BR2_PACKAGE_DIRECTFB=y
BR2_PACKAGE_XORG7=y
BR2_PACKAGE_X11VNC=y
BR2_PACKAGE_BLUEZ5_UTILS=y
BR2_PACKAGE_DHCP=y
BR2_PACKAGE_DHCP_CLIENT=y
BR2_PACKAGE_IPUTILS=y
```

## board/licheepi/licheepi_zero_defconfig
```kconfig
# Target options
BR2_arm=y
BR2_cortex_a7=y
BR2_ARM_FPU_VFPV4=y

# Toolchain
BR2_TOOLCHAIN_BUILDROOT_VENDOR="v3s"
BR2_TOOLCHAIN_BUILDROOT_GLIBC=y
BR2_PACKAGE_HOST_LINUX_HEADERS_CUSTOM_5_4=y

# GCC Options
BR2_TOOLCHAIN_BUILDROOT_CXX=y
BR2_GCC_ENABLE_LTO=y

# Kernel
BR2_LINUX_KERNEL=y
BR2_LINUX_KERNEL_CUSTOM_VERSION=y
BR2_LINUX_KERNEL_CUSTOM_VERSION_VALUE="5.4.113"
BR2_LINUX_KERNEL_USE_CUSTOM_CONFIG=y
BR2_LINUX_KERNEL_CUSTOM_CONFIG_FILE="board/licheepi/linux.defconfig"
BR2_LINUX_KERNEL_DTS_SUPPORT=y
BR2_LINUX_KERNEL_CUSTOM_DTS_PATH="board/licheepi/devicetree/linux/sun8i-v3s.dtsi board/licheepi/devicetree/linux/sun8i-v3s-prince.dts"
BR2_LINUX_KERNEL_PATCH="board/licheepi/patch/linux"

# Filesystem images
BR2_ROOTFS_DEVICE_CREATION_DYNAMIC_EUDEV=y
BR2_ROOTFS_OVERLAY="board/licheepi/rootfs"
BR2_TARGET_ROOTFS_SQUASHFS=y
BR2_TARGET_ROOTFS_SQUASHFS4_GZIP=y

# Bootloaders
BR2_TARGET_UBOOT=y
BR2_TARGET_UBOOT_BUILD_SYSTEM_KCONFIG=y
BR2_TARGET_UBOOT_CUSTOM_VERSION=y
BR2_TARGET_UBOOT_CUSTOM_VERSION_VALUE="2020.04"
# BR2_TARGET_UBOOT_CUSTOM_GIT=y
# BR2_TARGET_UBOOT_CUSTOM_REPO_URL="https://github.com/aodzip/u-boot.git"
# BR2_TARGET_UBOOT_CUSTOM_REPO_VERSION="Allwinner-S3"
BR2_TARGET_UBOOT_USE_CUSTOM_CONFIG=y
BR2_TARGET_UBOOT_CUSTOM_CONFIG_FILE="board/licheepi/uboot.defconfig"
BR2_TARGET_UBOOT_NEEDS_DTC=y
BR2_TARGET_UBOOT_NEEDS_PYLIBFDT=y
BR2_TARGET_UBOOT_FORMAT_CUSTOM=y
BR2_TARGET_UBOOT_FORMAT_CUSTOM_NAME="u-boot-sunxi-with-spl.bin"
BR2_TARGET_UBOOT_PATCH="board/licheepi/patch/u-boot"
BR2_TARGET_UBOOT_CUSTOM_DTS_PATH="board/licheepi/devicetree/uboot/sun8i-v3s-prince.dts"
BR2_TARGET_UBOOT_TOOLS=y
BR2_TARGET_UBOOT_BOOT_SCRIPT=y
BR2_TARGET_UBOOT_BOOT_SCRIPT_SOURCE="board/licheepi/boot.cmd"

# System configuration
BR2_TARGET_GENERIC_HOSTNAME="prince"
BR2_TARGET_GENERIC_ISSUE="Welcome Prince"
BR2_TARGET_GENERIC_GETTY_PORT="ttyS0"
BR2_TARGET_GENERIC_GETTY_BAUDRATE_115200=y
BR2_ROOTFS_POST_IMAGE_SCRIPT="board/licheepi/scripts/genimage.sh"
BR2_ROOTFS_POST_SCRIPT_ARGS="${BR2_TARGET_UBOOT_FORMAT_CUSTOM_NAME}"

# Host Config
BR2_PACKAGE_HOST_DOSFSTOOLS=y
BR2_PACKAGE_HOST_GENIMAGE=y
BR2_PACKAGE_HOST_MTOOLS=y
BR2_PACKAGE_HOST_PYTHON3=y
BR2_PACKAGE_HOST_PYTHON3_SSL=y
BR2_PACKAGE_HOST_UBOOT_TOOLS=y
BR2_PACKAGE_HOST_UBOOT_TOOLS_FIT_SUPPORT=y
BR2_PACKAGE_HOST_UBOOT_TOOLS_FIT_SIGNATURE_SUPPORT=y
BR2_PACKAGE_HOST_UBOOT_TOOLS_BOOT_SCRIPT=y
BR2_PACKAGE_HOST_UBOOT_TOOLS_BOOT_SCRIPT_SOURCE="board/licheepi/boot.cmd"

# Required host utilities for building an SDCard image
BR2_PACKAGE_TSLIB=y
BR2_PACKAGE_WPA_SUPPLICANT=y
BR2_PACKAGE_WPA_SUPPLICANT_AUTOSCAN=y
BR2_PACKAGE_BUSYBOX_SHOW_OTHERS=y
BR2_PACKAGE_VIM=y
BR2_PACKAGE_DNSMASQ=y
BR2_PACKAGE_DROPBEAR=y
BR2_PACKAGE_IPROUTE2=y
BR2_PACKAGE_NGINX=y
BR2_PACKAGE_E2FSPROGS=y
BR2_PACKAGE_E2FSPROGS_RESIZE2FS=y
BR2_PACKAGE_LIBPLIST=y
BR2_PACKAGE_GNUTLS=y
BR2_PACKAGE_LIBGCRYPT=y
BR2_PACKAGE_READLINE=y
BR2_PACKAGE_SSHPASS=y
BR2_PACKAGE_LIBIMOBILEDEVICE=y
BR2_PACKAGE_LIBIRECOVERY=y
BR2_PACKAGE_LIBUSBMUXD=y
BR2_PACKAGE_USBMUXD=y
BR2_PACKAGE_NTP=y
BR2_PACKAGE_NTP_NTPDATE=y
BR2_PACKAGE_OPENSSH=y
BR2_PACKAGE_USBUTILS=y
BR2_PACKAGE_LRZSZ=y
BR2_PACKAGE_TINYALSA=y
BR2_PACKAGE_LIBCEDARC=y
BR2_PACKAGE_LIBCEDARC_DECODER=y
BR2_PACKAGE_LIBCEDARC_OPENMAX=y
BR2_PACKAGE_FFMPEG=y
BR2_PACKAGE_FFMPEG_FFPLAY=y
BR2_PACKAGE_FFMPEG_EXTRACONF="--enable-omx"
BR2_PACKAGE_MYFFMPEG=y
```

## board/licheepi/uboot.defconfig
```kconfig
CONFIG_ARM=y
CONFIG_ARCH_SUNXI=y
CONFIG_SPL=y
CONFIG_DRAM_CLK=360
CONFIG_MACH_SUN8I_V3S=y
CONFIG_DRAM_ZQ=14779
CONFIG_SUN8I_EMAC=y
CONFIG_DM_ETH=y
CONFIG_MII=y
CONFIG_DM_MDIO_MUX=y

CONFIG_DEFAULT_DEVICE_TREE="sun8i-v3s-prince"
CONFIG_CMD_BOOTMENU=y
CONFIG_CMD_MEMINFO=y
CONFIG_BOOTDELAY=0
CONFIG_SYS_PROMPT="Prince> "

CONFIG_MMC=y
CONFIG_MMC_SUNXI_SLOT_EXTRA=2
# CONFIG_MMC0_CD_PIN="PF6"

CONFIG_CMD_BMP=y
CONFIG_DM_VIDEO=y
CONFIG_VIDEO_SUNXI=y
CONFIG_VIDEO_DE2=y
CONFIG_OF_BOARD_SETUP=y
CONFIG_VIDEO_BPP8=y
CONFIG_VIDEO_SIMPLE=y
CONFIG_VIDEO_DT_SIMPLEFB=n

CONFIG_DM_REGULATOR=y
CONFIG_REGULATOR_PWM=y
CONFIG_DM_PWM=y
CONFIG_PWM_SUNXI=y
CONFIG_BACKLIGHT_PWM=y

# USB
CONFIG_USB_GADGET_VBUS_DRAW=250
CONFIG_USB_MUSB_GADGET=y
CONFIG_USB_MUSB_SUNXI=y
CONFIG_USB_MUSB_DISABLE_BULK_COMBINE_SPLIT=y
CONFIG_USB_MUSB_PIO_ONLY=y
CONFIG_USB_STORAGE=y
CONFIG_PHY=y
CONFIG_PHY_SUN4I_USB=y
CONFIG_USB_EHCI_HCD=y
CONFIG_USB_EHCI_GENERIC=y
CONFIG_USB_OHCI_HCD=y
CONFIG_USB_OHCI_GENERIC=y
CONFIG_CMD_USB_MASS_STORAGE=y
```

## board/orangepi/orangepi-pc2/orangepi_pc2_defconfig
```kconfig
BR2_aarch64=y
BR2_cortex_a53=y
BR2_ARM_FPU_VFPV4=y

# Linux headers same as kernel, a 5.0 series
BR2_PACKAGE_HOST_LINUX_HEADERS_CUSTOM_5_0=y
BR2_TOOLCHAIN_BUILDROOT_VENDOR="pc2"
BR2_TOOLCHAIN_BUILDROOT_GLIBC=y
BR2_TOOLCHAIN_BUILDROOT_CXX=y
BR2_GCC_ENABLE_LTO=y

# Firmware
BR2_TARGET_ARM_TRUSTED_FIRMWARE=y
BR2_TARGET_ARM_TRUSTED_FIRMWARE_CUSTOM_GIT=y
BR2_TARGET_ARM_TRUSTED_FIRMWARE_CUSTOM_REPO_URL="https://github.com/apritzel/arm-trusted-firmware.git"
BR2_TARGET_ARM_TRUSTED_FIRMWARE_PLATFORM="sun50iw1p1"
BR2_TARGET_ARM_TRUSTED_FIRMWARE_CUSTOM_REPO_VERSION="aa75c8da415158a94b82a430b2b40000778e851f"
BR2_TARGET_ARM_TRUSTED_FIRMWARE_BL31=y

# Bootloader
BR2_TARGET_UBOOT=y
BR2_TARGET_UBOOT_BUILD_SYSTEM_KCONFIG=y
BR2_TARGET_UBOOT_CUSTOM_VERSION=y
BR2_TARGET_UBOOT_CUSTOM_VERSION_VALUE="2019.01"
BR2_TARGET_UBOOT_USE_CUSTOM_CONFIG=y
BR2_TARGET_UBOOT_CUSTOM_CONFIG_FILE="board/orangepi/orangepi-pc2/uboot.defconfig"
BR2_TARGET_UBOOT_CUSTOM_DTS_PATH="board/orangepi/orangepi-pc2/devicetree/uboot/sun50i-h5-orangepi-pc2.dts"
BR2_TARGET_UBOOT_NEEDS_DTC=y
BR2_TARGET_UBOOT_NEEDS_PYLIBFDT=y
BR2_TARGET_UBOOT_NEEDS_ATF_BL31=y
BR2_TARGET_UBOOT_FORMAT_CUSTOM=y
BR2_TARGET_UBOOT_FORMAT_CUSTOM_NAME="u-boot.itb"
BR2_TARGET_UBOOT_SPL=y
BR2_TARGET_UBOOT_SPL_NAME="spl/sunxi-spl.bin"
BR2_TARGET_UBOOT_TOOLS=y
BR2_TARGET_UBOOT_BOOT_SCRIPT=y
BR2_TARGET_UBOOT_BOOT_SCRIPT_SOURCE="board/orangepi/orangepi-pc2/boot.cmd"

# Kernel
BR2_LINUX_KERNEL=y
BR2_LINUX_KERNEL_CUSTOM_VERSION=y
BR2_LINUX_KERNEL_CUSTOM_VERSION_VALUE="5.0"
BR2_LINUX_KERNEL_USE_CUSTOM_CONFIG=y
BR2_LINUX_KERNEL_CUSTOM_CONFIG_FILE="board/orangepi/orangepi-pc2/linux.defconfig"
BR2_LINUX_KERNEL_DTS_SUPPORT=y
BR2_LINUX_KERNEL_INTREE_DTS_NAME="allwinner/sun50i-h5-orangepi-pc2"
BR2_LINUX_KERNEL_CUSTOM_DTS_PATH="board/orangepi/orangepi-pc2/devicetree/linux"
BR2_LINUX_KERNEL_NEEDS_HOST_OPENSSL=y

# Filesystem
BR2_TARGET_GENERIC_ISSUE="Welcome to Orangepi PC2"
BR2_TARGET_GENERIC_HOSTNAME="prince"
BR2_TARGET_ROOTFS_SQUASHFS=y
BR2_TARGET_ROOTFS_SQUASHFS4_GZIP=y
BR2_PACKAGE_HOST_DOSFSTOOLS=y
BR2_PACKAGE_HOST_GENIMAGE=y
BR2_PACKAGE_HOST_MTOOLS=y
BR2_ROOTFS_POST_IMAGE_SCRIPT="support/scripts/genimage.sh"
BR2_ROOTFS_POST_SCRIPT_ARGS="-c board/orangepi/orangepi-pc2/genimage.cfg"
BR2_ROOTFS_OVERLAY="board/orangepi/orangepi-pc2/rootfs"
BR2_ROOTFS_DEVICE_CREATION_DYNAMIC_EUDEV=y

# packages
BR2_PACKAGE_BUSYBOX_SHOW_OTHERS=y
BR2_PACKAGE_VIM=y
BR2_PACKAGE_DNSMASQ=y
BR2_PACKAGE_DROPBEAR=y
BR2_PACKAGE_IPROUTE2=y
BR2_PACKAGE_NGINX=y
BR2_PACKAGE_E2FSPROGS=y
BR2_PACKAGE_E2FSPROGS_RESIZE2FS=y
BR2_PACKAGE_LIBPLIST=y
BR2_PACKAGE_GNUTLS=y
BR2_PACKAGE_LIBGCRYPT=y
BR2_PACKAGE_READLINE=y
BR2_PACKAGE_SSHPASS=y
BR2_PACKAGE_LIBIMOBILEDEVICE=y
BR2_PACKAGE_LIBIRECOVERY=y
BR2_PACKAGE_LIBUSBMUXD=y
BR2_PACKAGE_USBMUXD=y
BR2_PACKAGE_NTP=y
BR2_PACKAGE_NTP_NTPDATE=y
BR2_PACKAGE_OPENSSH=y
BR2_PACKAGE_USBUTILS=y
BR2_PACKAGE_SUNXI_MALI_MAINLINE=y
BR2_PACKAGE_FB_TEST_APP=y
BR2_PACKAGE_MESA3D=y
BR2_PACKAGE_QT5=y
BR2_PACKAGE_QT5BASE_GUI=y
BR2_PACKAGE_QT5BASE_OPENGL=y
```

## board/radxa/rockpi-s/rock_pi_s_defconfig
```kconfig
# Architecture
BR2_aarch64=y
BR2_BINFMT_ELF=y
BR2_cortex_a35=y
BR2_ARM_FPU_VFPV4=y

# Linux headers same as kernel, a 4.4 series
BR2_PACKAGE_HOST_LINUX_HEADERS_CUSTOM_4_4=y
BR2_TOOLCHAIN_BUILDROOT_GLIBC=y
BR2_TOOLCHAIN_BUILDROOT_CXX=y
BR2_TOOLCHAIN_BUILDROOT_VENDOR="rk3308"
BR2_GCC_ENABLE_LTO=y
BR2_GCC_ENABLE_OPENMP=y

# Firmware
BR2_TARGET_ARM_TRUSTED_FIRMWARE=y
BR2_TARGET_ARM_TRUSTED_FIRMWARE_CUSTOM_GIT=y
BR2_TARGET_ARM_TRUSTED_FIRMWARE_CUSTOM_REPO_URL="https://github.com/atf-builds/atf.git"
BR2_TARGET_ARM_TRUSTED_FIRMWARE_CUSTOM_REPO_VERSION="cd9bafdfd8cac8b8dc7e09ca2bf48fcfbe21ce04"
BR2_TARGET_ARM_TRUSTED_FIRMWARE_PLATFORM="rk3328"
BR2_TARGET_ARM_TRUSTED_FIRMWARE_BL31=y
BR2_TARGET_ARM_TRUSTED_FIRMWARE_NEEDS_ARM32_TOOLCHAIN=y
BR2_TARGET_ARM_TRUSTED_FIRMWARE_IMAGES=""

# Bootloader
BR2_TARGET_UBOOT=y
BR2_TARGET_UBOOT_BUILD_SYSTEM_KCONFIG=y
BR2_TARGET_UBOOT_CUSTOM_GIT=y
BR2_TARGET_UBOOT_CUSTOM_REPO_URL="https://github.com/radxa/u-boot.git"
BR2_TARGET_UBOOT_CUSTOM_REPO_VERSION="6d910b7f12318e5a5bb8d1b2093fe5a9ba17dfce"
BR2_TARGET_UBOOT_BOARD_DEFCONFIG="rk3308-aarch32"
BR2_TARGET_UBOOT_NEEDS_DTC=y
BR2_TARGET_UBOOT_NEEDS_PYTHON3=y
# BR2_TARGET_UBOOT_NEEDS_ATF_BL31=y
# BR2_TARGET_UBOOT_NEEDS_ATF_BL31_ELF=y
BR2_TARGET_UBOOT_FORMAT_CUSTOM=y
BR2_TARGET_UBOOT_FORMAT_CUSTOM_NAME="u-boot.itb"
BR2_TARGET_UBOOT_SPL=y
BR2_TARGET_UBOOT_SPL_NAME="idbloader.img"

# Kernel
BR2_LINUX_KERNEL=y
# BR2_LINUX_KERNEL_CUSTOM_VERSION=y
# BR2_LINUX_KERNEL_CUSTOM_VERSION_VALUE="5.4.46"
# BR2_LINUX_KERNEL_USE_ARCH_DEFAULT_CONFIG=y
BR2_LINUX_KERNEL_CUSTOM_GIT=y
BR2_LINUX_KERNEL_CUSTOM_REPO_URL="https://github.com/radxa/kernel.git"
BR2_LINUX_KERNEL_CUSTOM_REPO_VERSION="stable-4.4-rockpis"
BR2_LINUX_KERNEL_USE_DEFCONFIG=y
BR2_LINUX_KERNEL_DEFCONFIG="rk3308_linux_defconfig"
BR2_LINUX_KERNEL_DTS_SUPPORT=y
BR2_LINUX_KERNEL_INTREE_DTS_NAME="rockchip/rk3308-rock-pi-s"
BR2_LINUX_KERNEL_NEEDS_HOST_OPENSSL=y

# Host Config
BR2_PACKAGE_HOST_PYTHON3=y
BR2_PACKAGE_HOST_PYTHON3_SSL=y
BR2_PACKAGE_HOST_UBOOT_TOOLS=y
BR2_PACKAGE_HOST_UBOOT_TOOLS_FIT_SUPPORT=y
BR2_PACKAGE_HOST_UBOOT_TOOLS_FIT_SIGNATURE_SUPPORT=y

#root fs
BR2_ROOTFS_DEVICE_CREATION_DYNAMIC_EUDEV=y
BR2_ROOTFS_POST_IMAGE_SCRIPT="support/scripts/genimage.sh"
BR2_ROOTFS_POST_SCRIPT_ARGS="-c board/radxa/rockpi-s/genimage.cfg"
BR2_ROOTFS_POST_BUILD_SCRIPT="board/radxa/rockpi-s/post-build.sh"
BR2_ROOTFS_OVERLAY="board/radxa/rockpi-s/fs-overlay"
BR2_TARGET_ROOTFS_EXT2=y
BR2_TARGET_ROOTFS_EXT2_2r0=y
BR2_TARGET_ROOTFS_EXT2_SIZE="128M"
BR2_TARGET_ROOTFS_SQUASHFS=y

# Filesystem
BR2_TARGET_TZ_INFO=y
BR2_TARGET_LOCALTIME="Asia/Shanghai"
BR2_TARGET_GENERIC_HOSTNAME="rockpis"
BR2_TARGET_GENERIC_ISSUE="Welcome to ROCK_PI_S"
BR2_PACKAGE_BUSYBOX_CONFIG="board/radxa/rockpi-s/busybox.config"
BR2_PACKAGE_ROCKCHIP=y
BR2_PACKAGE_E2FSPROGS=y
BR2_PACKAGE_E2FSPROGS_RESIZE2FS=y
BR2_PACKAGE_DUERCLIENTSDK=y
BR2_PACKAGE_SOFTAP=y
BR2_PACKAGE_RKWIFIBT=y
BR2_PACKAGE_EQ_DRC_PROCESS=y
BR2_PACKAGE_CYPRESS_BSA=y
BR2_PACKAGE_UPDATE=y
BR2_PACKAGE_RKSCRIPT=y
BR2_PACKAGE_CA_CERTIFICATES=y
BR2_PACKAGE_READLINE=y
BR2_PACKAGE_DHCPCD=y
BR2_PACKAGE_DNSMASQ=y
BR2_PACKAGE_HOSTAPD=y
BR2_PACKAGE_IW=y
BR2_PACKAGE_LRZSZ=y
BR2_PACKAGE_NTP=y
BR2_PACKAGE_NTP_NTPDATE=y
BR2_PACKAGE_WPA_SUPPLICANT=y
BR2_PACKAGE_WPA_SUPPLICANT_AUTOSCAN=y
BR2_PACKAGE_WPA_SUPPLICANT_WPS=y
BR2_PACKAGE_WPA_SUPPLICANT_CLI=y
BR2_PACKAGE_WPA_SUPPLICANT_WPA_CLIENT_SO=y
```

## package/fb2png/Config.in
```kconfig
config BR2_PACKAGE_FB2PNG
	bool "fb2png"
	depends on BR2_INSTALL_LIBSTDCPP
	help
	  Test spi interface lcd display png

comment "spitft needs a toolchain w/ C++"
	depends on !BR2_INSTALL_LIBSTDCPP
```

## package/fbi-improved/Config.in
```kconfig
config BR2_PACKAGE_FBI_IMPROVED
	bool "fbi-improved"
	depends on BR2_INSTALL_LIBSTDCPP
	select BR2_PACKAGE_LIBEXIF
	select BR2_PACKAGE_JPEG
	select BR2_PACKAGE_LIBDJVULIBRE
	select BR2_PACKAGE_TIFF
	select BR2_PACKAGE_LIBPNG
	help
	  fbi improved
```

## package/klipper/Config.in
```kconfig
source "package/klipper/klipper3d/Config.in"
source "package/klipper/klipper3d-repl/Config.in"
source "package/klipper/klipper3d-wrecklab/Config.in"
source "package/klipper/moonraker/Config.in"
source "package/klipper/python-streaming-form-data/Config.in"
```

## package/klipper/moonraker/Config.in
```kconfig
config BR2_PACKAGE_MOONRAKER
	bool "moonraker"
	
	select BR2_PACKAGE_KLIPPER3D
	select BR2_PACKAGE_LIBSODIUM
	select BR2_PACKAGE_JPEG
	select BR2_PACKAGE_ZLIB
	select BR2_PACKAGE_LIBCURL_CURL
	select BR2_PACKAGE_WIRELESS_TOOLS
	select BR2_PACKAGE_IW
	select BR2_PACKAGE_PYTHON_TORNADO
	select BR2_PACKAGE_PYTHON_WEBSOCKETS
	select BR2_PACKAGE_PYTHON_STREAMING_FORM_DATA

	help
	  Moonraker is a Python 3 based web server that exposes
	  APIs with which client applications may use to interact
	  with the 3D printing firmware Klipper. 
	  Communication between the Klippy host and Moonraker is done over a Unix Domain Socket. 
	  Tornado is used to provide Moonraker's server functionality.

	  https://github.com/Arksine/moonraker
```
