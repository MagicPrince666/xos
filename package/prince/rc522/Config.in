## package/prince/rc522/Config.in
```kconfig
config BR2_PACKAGE_RC522
	bool "nfc rc522"
	depends on BR2_INSTALL_LIBSTDCPP
	help
	  Test spi interface with sonny ps2

comment "sonny ps2 needs a toolchain w/ C++"
	depends on !BR2_INSTALL_LIBSTDCPP
```

## package/prince/remotecar/Config.in
```kconfig
menuconfig BR2_PACKAGE_REMOTECAR
	bool "remotecar"
	depends on BR2_INSTALL_LIBSTDCPP
	help
		A linux remote car
```

## package/prince/sound/Config.in
```kconfig
config BR2_PACKAGE_SOUND
	bool "sound play"
	depends on BR2_INSTALL_LIBSTDCPP
	select BR2_PACKAGE_ALSA_LIB
	select BR2_PACKAGE_LIBMAD
	select BR2_PACKAGE_LIBID3TAG
	help
	  Test sound display

comment "sonny ps2 needs a toolchain w/ C++"
	depends on !BR2_INSTALL_LIBSTDCPP
```

## package/prince/spitft/Config.in
```kconfig
config BR2_PACKAGE_SPITFT
	bool "spitft"
	depends on BR2_INSTALL_LIBSTDCPP
	help
	  Test spi interface lcd

comment "spitft needs a toolchain w/ C++"
	depends on !BR2_INSTALL_LIBSTDCPP
```

## package/prince/touchscreen/Config.in
```kconfig
config BR2_PACKAGE_TOUCHSCREEN
	bool "touchscreen"
	depends on BR2_INSTALL_LIBSTDCPP
	help
	  Test touch screen

comment "touch screen needs a toolchain w/ C++"
	depends on !BR2_INSTALL_LIBSTDCPP
```

## package/prince/ui4linux/Config.in
```kconfig
config BR2_PACKAGE_UI4LINUX
	bool "ui for linux"
	depends on BR2_INSTALL_LIBSTDCPP
	select BR2_PACKAGE_LIBPNG
	select BR2_PACKAGE_ZLIB
	help
	  Test spi interface lcd ui

comment "ui for linux needs a toolchain w/ C++"
	depends on !BR2_INSTALL_LIBSTDCPP
```

## package/prince/ultrasonic/Config.in
```kconfig
config BR2_PACKAGE_ULTRASONIC
	bool "ultrasonic"
	depends on BR2_INSTALL_LIBSTDCPP
	help
	  Test ultrasonic senser

comment "sonny ps2 needs a toolchain w/ C++"
	depends on !BR2_INSTALL_LIBSTDCPP
```

## package/prince/usbmuxd/Config.in
```kconfig
config BR2_PACKAGE_USBMUXD
	bool "usbmuxd"
	help
	  A socket daemon to multiplex connections from and to iOS devices.

	  https://github.com/libimobiledevice/usbmuxd
```

## package/prince/wl8puart/Config.in
```kconfig
config BR2_PACKAGE_WL8PUART
	bool "wl8puart"
	help
	  Test usb uart interface with wl8puart
```
