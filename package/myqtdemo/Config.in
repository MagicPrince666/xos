## package/myqtdemo/Config.in
```kconfig
config BR2_PACKAGE_MYQTDEMO
	bool "myqtdemo"
	depends on BR2_INSTALL_LIBSTDCPP
	help
	  My qt demo

comment "my qt demo needs a toolchain w/ C++"
	depends on !BR2_INSTALL_LIBSTDCPP
```

## package/pongoos/Config.in
```kconfig
config BR2_PACKAGE_PONGOOS
	bool "pongoos"
	depends on BR2_INSTALL_LIBSTDCPP
	help
	  A pre-boot execution environment for 
	  Apple boards built on top of checkra1n.
```

## package/prince/Config.in
```kconfig
source "package/prince/libimobiledevice/Config.in"
source "package/prince/libusbmuxd/Config.in"
source "package/prince/usbmuxd/Config.in"
source "package/prince/libplist/Config.in"
source "package/prince/libirecovery/Config.in"
source "package/prince/idevicerestore/Config.in"
source "package/prince/ideviceinstaller/Config.in"
source "package/prince/ifuse/Config.in"
source "package/prince/libideviceactivation/Config.in"
source "package/prince/factory/Config.in"
source "package/prince/myjpeg/Config.in"
source "package/prince/myopencv/Config.in"
source "package/prince/pongoos/Config.in"
source "package/prince/spitft/Config.in"
source "package/prince/fb2png/Config.in"
source "package/prince/ui4linux/Config.in"
source "package/prince/fbi-improved/Config.in"
source "package/prince/libdjvulibre/Config.in"
source "package/prince/lvgl/Config.in"
source "package/prince/mp4player/Config.in"
source "package/prince/myffmpeg/Config.in"
source "package/prince/sonnyps2/Config.in"
source "package/prince/rc522/Config.in"
source "package/prince/psxpad/Config.in"
source "package/prince/ir-remote/Config.in"
source "package/prince/joystick/Config.in"
source "package/prince/sound/Config.in"
source "package/prince/ultrasonic/Config.in"
source "package/prince/inv_mpu/Config.in"
source "package/prince/mp3play/Config.in"
source "package/prince/hx711/Config.in"
source "package/prince/touchscreen/Config.in"
source "package/prince/libimobiledevice-glue/Config.in"
source "package/prince/diskutils/Config.in"
source "package/prince/wl8puart/Config.in"
```

## package/prince/diskutils/Config.in
```kconfig
menuconfig BR2_PACKAGE_WLUTILS
	bool "diskutils"
	depends on BR2_INSTALL_LIBSTDCPP
	help
		WL apple disk utils
```

## package/prince/factory/Config.in
```kconfig
config BR2_PACKAGE_FACTORY
	bool "factory"
	depends on BR2_INSTALL_LIBSTDCPP
	help
	  Display jpeg

comment "imuspx4 needs a toolchain w/ C++"
	depends on !BR2_INSTALL_LIBSTDCPP
```

## package/prince/hx711/Config.in
```kconfig
menuconfig BR2_PACKAGE_HX711
	bool "hx711"
	depends on BR2_INSTALL_LIBSTDCPP
	help
		HX711 weight scale interface
```

## package/prince/ideviceinstaller/Config.in
```kconfig
config BR2_PACKAGE_IDEVICEINSTALLER
	bool "ideviceinstaller"
	select BR2_PACKAGE_LIBUSB
	select BR2_PACKAGE_LIBZIP
	help
	  The ideviceinstaller library allows communication with iBoot/iBSS of iOS devices via USB.

	  https://github.com/libimobiledevice/ideviceinstaller
```

## package/prince/idevicerestore/Config.in
```kconfig
config BR2_PACKAGE_IDEVICERESTORE
	bool "idevicerestore"
	select BR2_PACKAGE_OPENSSL
	select BR2_PACKAGE_LIBPLIST
	select BR2_PACKAGE_LIBUSBMUXD
	select BR2_PACKAGE_READLINE
	select BR2_PACKAGE_LIBIMOBILEDEVICE
	select BR2_PACKAGE_LIBIRECOVERY
	select BR2_PACKAGE_LIBZIP
	select BR2_PACKAGE_LIBCURL
	help
	  A command-line application to restore firmware files to iOS devices.

	  https://github.com/libimobiledevice/idevicerestore
```

## package/prince/ifuse/Config.in
```kconfig
config BR2_PACKAGE_IFUSE
	bool "ifuse"
	select BR2_PACKAGE_LIBFUSE
	help
	  The ifuse library allows communication with iBoot/iBSS of iOS devices via USB.

	  https://github.com/libimobiledevice/ifuse
```

## package/prince/inv_mpu/Config.in
```kconfig
config BR2_PACKAGE_INV_MPU
	bool "inv_mpu"
	depends on BR2_INSTALL_LIBSTDCPP
	help
	  Test invensense,mpu6500 senser

comment "sonny ps2 needs a toolchain w/ C++"
	depends on !BR2_INSTALL_LIBSTDCPP
```

## package/prince/ir-remote/Config.in
```kconfig
config BR2_PACKAGE_IR_REMOTE
	bool "ir remote"
	depends on BR2_INSTALL_LIBSTDCPP
	help
	  Test ir remote

comment "sonny ps2 needs a toolchain w/ C++"
	depends on !BR2_INSTALL_LIBSTDCPP
```

## package/prince/joystick/Config.in
```kconfig
config BR2_PACKAGE_JOYSTICK
	bool "joystick"
	depends on BR2_INSTALL_LIBSTDCPP
	help
	  Test joystick

comment "sonny ps2 needs a toolchain w/ C++"
	depends on !BR2_INSTALL_LIBSTDCPP
```

## package/prince/jshon/Config.in
```kconfig
config BR2_PACKAGE_JSHON
	bool "jshon"
	depends on BR2_PACKAGE_JANSSON
	help
	  This is a lightweight JSON parser in C.

comment "libplist needs a toolchain w/ C++, threads"
	depends on !BR2_INSTALL_LIBSTDCPP || !BR2_TOOLCHAIN_HAS_THREADS
```

## package/prince/libdjvulibre/Config.in
```kconfig
config BR2_PACKAGE_LIBDJVULIBRE
	bool "libdjvulibre"
	help
	  DjVu is a web-centric format and software platform for distributing documents and images

	  http://sourceforge.net/projects/djvu/
```

## package/prince/libideviceactivation/Config.in
```kconfig
config BR2_PACKAGE_LIBIDEVICEACTIVATION
	bool "libideviceactivation"
	select BR2_PACKAGE_LIBCURL
	select BR2_PACKAGE_LIBCURL_OPENSSL
	select BR2_PACKAGE_LIBXML2
	help
	  The libideviceactivation library allows communication with iBoot/iBSS of iOS devices via USB.

	  https://github.com/libimobiledevice/libideviceactivation
```

## package/prince/libimobiledevice/Config.in
```kconfig
config BR2_PACKAGE_LIBIMOBILEDEVICE
	bool "libimobiledevice"
	select BR2_PACKAGE_OPENSSL
	select BR2_PACKAGE_LIBPLIST
	select BR2_PACKAGE_LIBUSBMUXD
	select BR2_PACKAGE_READLINE
	help
	  A library to communicate with services on iOS devices
	  using native protocols.

	  https://github.com/libimobiledevice/libimobiledevice
```

## package/prince/libirecovery/Config.in
```kconfig
config BR2_PACKAGE_LIBIRECOVERY
	bool "libirecovery"
	select BR2_PACKAGE_LIBUSB
	help
	  The libirecovery library allows communication with iBoot/iBSS of iOS devices via USB.

	  https://github.com/libimobiledevice/libirecovery
```

## package/prince/libsfml/Config.in
```kconfig
config BR2_PACKAGE_LIBSFML
	bool "libsfml"
	select BR2_PACKAGE_XORG7
	select BR2_PACKAGE_XAPP_XRANDR
	select BR2_PACKAGE_SDL2
	select BR2_PACKAGE_SDL2_X11
	help
	  Simple and Fast Multimedia Library

	  https://www.sfml-dev.org/
```

## package/prince/libusbmuxd/Config.in
```kconfig
config BR2_PACKAGE_LIBUSBMUXD
	bool "libusbmuxd"
	help
	  A client library for applications to handle usbmux protocol connections with iOS devices.

	  https://github.com/libimobiledevice/libusbmuxd
```

## package/prince/lvgl/Config.in
```kconfig
config BR2_PACKAGE_LVGL
	bool "lvgl"
	select BR2_PACKAGE_TSLIB
	depends on BR2_INSTALL_LIBSTDCPP
	help
	  LVGL configured to work with /dev/fb0 on Linux.
```

## package/prince/mp3play/Config.in
```kconfig
config BR2_PACKAGE_MP3PLAY
	bool "mp3 play"
	depends on BR2_INSTALL_LIBSTDCPP
	select BR2_PACKAGE_ALSA_LIB
	select BR2_PACKAGE_MPG123
	help
	  Test mp3 display

comment "sonny ps2 needs a toolchain w/ C++"
	depends on !BR2_INSTALL_LIBSTDCPP
```

## package/prince/mp4player/Config.in
```kconfig
config BR2_PACKAGE_MP4PLAYER
	bool "mp4player"
	depends on BR2_INSTALL_LIBSTDCPP
	select BR2_PACKAGE_FFMPEG
	select BR2_PACKAGE_FFMPEG_FFPLAY
	select BR2_PACKAGE_SDL2
	help
	  f1c100s mp4 player

comment "imuspx4 needs a toolchain w/ C++"
	depends on !BR2_INSTALL_LIBSTDCPP
```

## package/prince/myffmpeg/Config.in
```kconfig
config BR2_PACKAGE_MYFFMPEG
	bool "myffmpeg"
	depends on BR2_INSTALL_LIBSTDCPP
	select BR2_PACKAGE_FFMPEG
	select BR2_PACKAGE_FFMPEG_SWSCALE
	help
	  f1c100s mp4 player

comment "imuspx4 needs a toolchain w/ C++"
	depends on !BR2_INSTALL_LIBSTDCPP
```

## package/prince/myopencv/Config.in
```kconfig
config BR2_PACKAGE_MYOPENCV
	bool "myopencv"
	depends on BR2_INSTALL_LIBSTDCPP
	help
	  My opencv demo

comment "my opencv needs a toolchain w/ C++"
	depends on !BR2_INSTALL_LIBSTDCPP
```

## package/prince/psxpad/Config.in
```kconfig
config BR2_PACKAGE_PSXPAD
	bool "psxpad"
	depends on BR2_INSTALL_LIBSTDCPP
	help
	  Test spi interface with sonny ps2

comment "sonny ps2 needs a toolchain w/ C++"
	depends on !BR2_INSTALL_LIBSTDCPP
```
